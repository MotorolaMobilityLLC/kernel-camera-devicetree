/dts-v1/;
/plugin/;

#include <dt-bindings/clock/qcom,gcc-kera.h>
#include <dt-bindings/clock/qcom,camcc-sun.h>
#include <dt-bindings/clock/qcom,cambistmclkcc-sun.h>
#include <dt-bindings/interconnect/qcom,kera.h>
#include <dt-bindings/interrupt-controller/arm-gic.h>
#include <dt-bindings/regulator/qcom,rpmh-regulator-levels.h>

#include "kera-camera-sensor-roadstr-common.dtsi"
/ {
	model = "Qualcomm Technologies, Inc. Kera QRD";
	compatible = "qcom,kera-qrd", "qcom,kera", "qcom,kerap-qrd", "qcom,kerap",
			"qcom,qrd";
	qcom,msm-id = <686 0x10000>, <659 0x10000>;
	qcom,board-id = <0x41 0x9000>, <0x41 0xA100>, <0x441 0xA100>;
};
