/dts-v1/;
/plugin/;

#include <dt-bindings/clock/qcom,gcc-parrot.h>
#include <dt-bindings/clock/qcom,camcc-parrot.h>
#include <dt-bindings/interconnect/qcom,parrot.h>
#include <dt-bindings/interrupt-controller/arm-gic.h>
#include <dt-bindings/regulator/qcom,rpmh-regulator-levels.h>

#include "parrot-camera-sensor-cuscoi-noi-common.dtsi"
#define CUSCOI_RADIO_APEM1 6
#define CUSCOI_RADIO_INDIA1 7

/ {
	model = "cuscoi";
	compatible = "qcom,parrot-qrd", "qcom,parrot", "qcom,qrd", "moto,cuscoi";
	qcom,msm-id = <613 0x10000>;
	qcom,board-id = <(CUSCOI_RADIO_APEM1 << 8 | 0x45) 0x9000>, <(CUSCOI_RADIO_INDIA1 << 8|0x45) 0x9000>;
};
