// SPDX-License-Identifier: BSD-3-Clause
/*
 * Copyright (c) 2024 Qualcomm Innovation Center, Inc. All rights reserved.
 */

/dts-v1/;
/plugin/;

#include <dt-bindings/clock/qcom,gcc-canoe.h>
#include <dt-bindings/clock/qcom,camcc-canoe.h>
#include <dt-bindings/clock/qcom,cambistmclkcc-canoe.h>
#include <dt-bindings/interconnect/qcom,canoe.h>
#include <dt-bindings/interrupt-controller/arm-gic.h>
#include <dt-bindings/regulator/qcom,rpmh-regulator-levels.h>
#include <dt-bindings/clock/qcom,rpmh.h>

#include "canoe-camera-sensor-cdp.dtsi"
/ {
	model = "Qualcomm Technologies, Inc. canoe/honu CDP/RCM";
	compatible = "qcom,canoe", "qcom,canoep", "qcom,canoe-cdp",
		"qcom,canoep-cdp", "qcom,cdp", "qcom,canoe-rcm", "qcom,canoep-rcm",
		"qcom,rcm";
	qcom,msm-id = <660 0x10000>, <660 0x20000>, <661 0x10000>,
		<661 0x20000>, <0x1000294 0x10000>, <0x1000294 0x20000>,
		<0x1000295 0x10000>, <0x1000295 0x20000>,<0x10294 0x10000>,
		<0x10294 0x20000>, <0x10295 0x10000>, <0x10295 0x20000>,
		<0x1010294 0x10000>, <0x1010294 0x20000>, <0x1010295 0x10000>,
		<0x1010295 0x20000>;
	qcom,board-id = <1 0>, <0x20001 0>, <0x30001 0>, <0x1000001 0>,
		<0x2000001 0>, <0x15 0>, <0x20015 0>, <0x30015 0>, <0x1000015 0>,
		<0x2000015 0>;
};
