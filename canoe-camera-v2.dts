// SPDX-License-Identifier: BSD-3-Clause
/*
 * Copyright (c) 2025 Qualcomm Innovation Center, Inc. All rights reserved.
 */

/dts-v1/;
/plugin/;

#include <dt-bindings/clock/qcom,gcc-canoe.h>
#include <dt-bindings/clock/qcom,camcc-canoe.h>
#include <dt-bindings/interconnect/qcom,canoe.h>
#include <dt-bindings/interrupt-controller/arm-gic.h>
#include <dt-bindings/regulator/qcom,rpmh-regulator-levels.h>

#include "canoe-camera-v2.dtsi"
/ {
	model = "Qualcomm Technologies, Inc. canoe SoC";
	compatible = "qcom,canoe", "qcom,canoe-rcm", "qcom,canoep",
		"qcom,canoep-rcm", "qcom,canoe-qrd", "qcom,canoe-cdp",
		"qcom,canoep-cdp", "qcom,canoe-mtp", "qcom,canoe-atp",
		"qcom,canoep-atp", "qcom,mtp";
	qcom,msm-id = <660 0x20000>, <661 0x20000>, <0x1000294 0x20000>,
		<0x1000295 0x20000>, <0x10294 0x20000>, <0x10295 0x20000>,
		<0x1010294 0x20000>, <0x1010295 0x20000>;
	qcom,board-id = <0 0>;
};
