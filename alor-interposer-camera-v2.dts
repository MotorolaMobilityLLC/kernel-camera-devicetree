// SPDX-License-Identifier: BSD-3-Clause-Clear
/*
 * Copyright (c) Qualcomm Technologies, Inc. and/or its subsidiaries.
 */

/dts-v1/;
/plugin/;

#include <dt-bindings/clock/qcom,gcc-canoe.h>
#include <dt-bindings/clock/qcom,camcc-canoe.h>
#include <dt-bindings/interconnect/qcom,canoe.h>
#include <dt-bindings/interrupt-controller/arm-gic.h>
#include <dt-bindings/regulator/qcom,rpmh-regulator-levels.h>

#include "alor-interposer-camera-v2.dtsi"
/ {
	model = "Qualcomm Technologies, Inc. Alor Interposer SoC";
	compatible = "qcom,canoe", "qcom,canoe-rcm", "qcom,canoe-mtp", "qcom,mtp", "qcom,rcm";
	qcom,msm-id = <704 0x20000>, <0x10002C0 0x20000>;
	qcom,board-id = <0 0>;
};
