/dts-v1/;
/plugin/;

#define RTWO_RADIO_ATT 1
#include <dt-bindings/clock/qcom,gcc-khaje.h>
#include <dt-bindings/interconnect/qcom,bengal.h>
#include <dt-bindings/interrupt-controller/arm-gic.h>
#include <dt-bindings/regulator/qcom,rpmh-regulator-levels.h>

#include "khaje-camera-sensor-fogona-common.dtsi"
/ {
    model = "fogona";
    compatible = "qcom,khaje-idp", "qcom,khaje", "qcom,idp", "mot.fogona";
    qcom,msm-id = <518 0x10000>, <585 0x10000>, <586 0x10000>;
    qcom,board-id = <(RTWO_RADIO_ATT << 8 | 0x41) 0xB100>,<(RTWO_RADIO_ATT << 8 | 0x41) 0xB200>,<(RTWO_RADIO_ATT << 8 | 0x41) 0xA200>,<(RTWO_RADIO_ATT << 8 | 0x41) 0xC000>;
};
