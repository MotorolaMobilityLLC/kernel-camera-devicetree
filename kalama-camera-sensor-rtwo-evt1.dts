
/* this is derivated from qcom kalama-camera-sensor-mtp.dts */

/dts-v1/;
/plugin/;

#include <dt-bindings/clock/qcom,gcc-kalama.h>
#include <dt-bindings/clock/qcom,camcc-kalama.h>
#include <dt-bindings/interconnect/qcom,kalama.h>
#include <dt-bindings/interrupt-controller/arm-gic.h>
#include <dt-bindings/regulator/qcom,rpmh-regulator-levels.h>

#include "kalama-camera-sensor-rtwo-evt1.dtsi"

#define RTWO_RADIO_ROW 2
#define RTWO_RADIO_NA  3
#define RTWO_RADIO_VZM 4
/ {
	model = "rtwo";
	compatible = "qcom,kalama-mtp", "qcom,kalama", "qcom,mtp", "mot,rtwo";
	qcom,msm-id = <519 0x10000>, <536 0x10000>, <519 0x20000>, <536 0x20000>;
	qcom,board-id = <0x41 0xA100>, <0x41 0xB1B0>, <0x41 0xC000>,
                    <(RTWO_RADIO_NA << 8 | 0x41) 0xA200>, <(RTWO_RADIO_VZM << 8 | 0x41) 0xA200>,
                    <(RTWO_RADIO_ROW << 8 | 0x41) 0xB1B0>;
};
