// SPDX-License-Identifier: BSD-3-Clause-Clear
/*
 * Copyright (c) Qualcomm Technologies, Inc. and/or its subsidiaries.
 */

/dts-v1/;
/plugin/;

#include <dt-bindings/clock/qcom,alor-gcc.h>
#include <dt-bindings/clock/qcom,alor-camcc.h>
#include <dt-bindings/clock/qcom,cambistmclkcc-canoe.h>
#include <dt-bindings/interconnect/qcom,alor.h>
#include <dt-bindings/interrupt-controller/arm-gic.h>
#include <dt-bindings/regulator/qcom,rpmh-regulator-levels.h>

#include "alor-camera-sensor-mtp-peach.dtsi"
/ {
	model = "Qualcomm Technologies, Inc. Alor MTP";
	compatible = "qcom,alor", "qcom,alor-mtp", "qcom,mtp";
	qcom,msm-id = <685 0x10000>, <727 0x10000>;
	qcom,board-id = <0x30008 0>;
};
