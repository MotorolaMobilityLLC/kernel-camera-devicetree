
/* this is derivated from qcom kalama-camera-sensor-mtp.dts */

/dts-v1/;
/plugin/;

#include <dt-bindings/clock/qcom,gcc-crow.h>
#include <dt-bindings/clock/qcom,camcc-crow.h>
#include <dt-bindings/interconnect/qcom,crow.h>
#include <dt-bindings/interrupt-controller/arm-gic.h>
#include <dt-bindings/regulator/qcom,rpmh-regulator-levels.h>

#include "crow-camera-sensor-eqe-common.dtsi"
/ {
        model = "eqe";
        compatible = "qcom,crow-idp", "qcom,crow", "qcom,idp", "qcom,eqe";
        qcom,msm-id = <608 0x10000>;
        qcom,board-id = <0x41 0xa000>;
};
