// SPDX-License-Identifier: BSD-3-Clause
/*
 * Copyright (c) 2024 Qualcomm Innovation Center, Inc. All rights reserved.
 */

/dts-v1/;
/plugin/;

#include <dt-bindings/clock/qcom,gcc-canoe.h>
#include <dt-bindings/clock/qcom,camcc-canoe.h>
#include <dt-bindings/clock/qcom,cambistmclkcc-canoe.h>
#include <dt-bindings/interconnect/qcom,canoe.h>
#include <dt-bindings/interrupt-controller/arm-gic.h>
#include <dt-bindings/regulator/qcom,rpmh-regulator-levels.h>
#include <dt-bindings/clock/qcom,rpmh.h>

#include "canoe-camera-sensor-mtp.dtsi"
/ {
	model = "Qualcomm Technologies, Inc. canoe/honu MTP";
	compatible = "qcom,canoe", "qcom,canoep", "qcom,canoe-mtp",
		"qcom,canoep-mtp", "qcom,mtp";
	qcom,msm-id = <660 0x10000>, <660 0x20000>, <661 0x10000>,
		<661 0x20000>, <0x1000294 0x10000>, <0x1000294 0x20000>,
		<0x1000295 0x10000>, <0x1000295 0x20000>,<0x10294 0x10000>,
		<0x10294 0x20000>, <0x10295 0x10000>, <0x10295 0x20000>,
		<0x1010294 0x10000>, <0x1010294 0x20000>, <0x1010295 0x10000>,
		<0x1010295 0x20000>;
	qcom,board-id = <8 0>, <0x108 0>, <0x208 0>, <0x20008 0>, <0x30008 0>,
		<0x40008 0>, <0x50008 0>, <0x60008 0>, <0x70008 0>, <0x1000008 0>,
		<0x2000008 0>;
};
