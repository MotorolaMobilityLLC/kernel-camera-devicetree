/dts-v1/;
/plugin/;

#include <dt-bindings/clock/qcom,gcc-parrot.h>
#include <dt-bindings/clock/qcom,camcc-parrot.h>
#include <dt-bindings/interconnect/qcom,parrot.h>
#include <dt-bindings/interrupt-controller/arm-gic.h>
#include <dt-bindings/regulator/qcom,rpmh-regulator-levels.h>

#include "parrot-camera-sensor-portov-common.dtsi"
/ {
	model = "portov";
	compatible = "qcom,parrot-qrd", "qcom,parrot", "qcom,qrd", "moto,portov";
	qcom,msm-id = <613 0x10000>;
	qcom,board-id = <0x46 0x9000>, <0x46 0xB100>, <0x47 0xB100>;
};
