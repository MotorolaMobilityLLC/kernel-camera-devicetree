// SPDX-License-Identifier: BSD-3-Clause
/*
 * Copyright (c) 2024 Qualcomm Innovation Center, Inc. All rights reserved.
 */

/dts-v1/;
/plugin/;

#include <dt-bindings/clock/qcom,gcc-canoe.h>
#include <dt-bindings/clock/qcom,camcc-canoe.h>
#include <dt-bindings/clock/qcom,cambistmclkcc-canoe.h>
#include <dt-bindings/interconnect/qcom,canoe.h>
#include <dt-bindings/interrupt-controller/arm-gic.h>
#include <dt-bindings/regulator/qcom,rpmh-regulator-levels.h>
#include <dt-bindings/clock/qcom,rpmh.h>

#include "canoe-camera-sensor-rumi.dtsi"
/ {
	model = "Qualcomm Technologies, Inc. canoe/honu RUMI";
	compatible = "qcom,canoe-rumi", "qcom,canoe", "qcom,rumi";
	qcom,msm-id = <0x10294 0x10000>, <0x10294 0x20000>;
	qcom,board-id = <15 0>;
};
