/dts-v1/;
/plugin/;

#include <dt-bindings/clock/qcom,gcc-parrot.h>
#include <dt-bindings/clock/qcom,camcc-parrot.h>
#include <dt-bindings/interconnect/qcom,parrot.h>
#include <dt-bindings/interrupt-controller/arm-gic.h>
#include <dt-bindings/regulator/qcom,rpmh-regulator-levels.h>

#include "parrot-camera-sensor-boston-common.dtsi"
/ {
	model = "boston";
	compatible = "qcom,parrot-qrd", "qcom,parrot", "qcom,qrd", "moto,boston";
	qcom,msm-id = <537 0x10000>;
	qcom,board-id = <0x44 0x9000>;
};
