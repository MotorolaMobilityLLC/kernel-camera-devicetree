
/* this is derivated from qcom kalama-camera-sensor-mtp.dts */

/dts-v1/;
/plugin/;

#include <dt-bindings/clock/qcom,gcc-kalama.h>
#include <dt-bindings/clock/qcom,camcc-kalama.h>
#include <dt-bindings/interconnect/qcom,kalama.h>
#include <dt-bindings/interrupt-controller/arm-gic.h>
#include <dt-bindings/regulator/qcom,rpmh-regulator-levels.h>

#include "kalama-camera-sensor-ctwo-common.dtsi"
/ {
	model = "ctwo";
	compatible = "qcom,kalama-mtp", "qcom,kalama", "qcom,mtp", "mot,ctwo";
	qcom,msm-id = <519 0x10000>, <536 0x10000>, <519 0x20000>, <536 0x20000>;
	qcom,board-id = <0x4b 0x9000>;
};
